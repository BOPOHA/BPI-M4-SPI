## src/spi/Kconfig
```kconfig
if TARGET_BPI_M4_FC
config BPI_M4_SPI
    bool
    default y
    select GICV2
config BPI_M4_RAM_SIZE
    hex "Installed RAM size (must match the packaged DDR settings)"
    default 0x80000000
config SYS_BOARD
    default "bpi-m4-fc"
config SYS_VENDOR
    default "bananapi"
config SYS_CONFIG_NAME
    default "bpi-m4-fc"
config TEXT_BASE
    default 0x00100000
config HAS_CUSTOM_SYS_INIT_SP_ADDR
    default y
config CUSTOM_SYS_INIT_SP_ADDR
    default 0x02080000
config SYS_LOAD_ADDR
    default 0x20000000
endif
```

## src/spi/defconfig
```kconfig
CONFIG_ARM=y
CONFIG_ARMV8_MULTIENTRY=y
CONFIG_ARMV8_SET_SMPEN=y
CONFIG_COUNTER_FREQUENCY=27000000
CONFIG_GICV2=y
CONFIG_TARGET_BPI_M4_FC=y
CONFIG_TEXT_BASE=0x00100000
CONFIG_SYS_MALLOC_LEN=0x800000
CONFIG_SYS_MALLOC_F_LEN=0x4000
CONFIG_CUSTOM_SYS_INIT_SP_ADDR=0x02080000
CONFIG_SYS_LOAD_ADDR=0x20000000
CONFIG_DEFAULT_DEVICE_TREE="bpi-m4-fc"
CONFIG_BOOTDELAY=1
CONFIG_USE_BOOTCOMMAND=y
CONFIG_BOOTCOMMAND="bpispiboot"
CONFIG_SYS_PROMPT="BPI-M4(SPI)> "
CONFIG_SYS_CBSIZE=2048
CONFIG_HUSH_PARSER=y
CONFIG_CMD_BOOTI=y
CONFIG_SUPPORT_RAW_INITRD=y
CONFIG_CMD_FAT=y
CONFIG_CMD_MMC=y
CONFIG_CMD_MEMORY=y
CONFIG_CMD_HASH=y
CONFIG_HASH=y
CONFIG_SHA256=y
CONFIG_OF_CONTROL=y
CONFIG_OF_SEPARATE=y
CONFIG_DM=y
CONFIG_DM_SERIAL=y
CONFIG_SYS_NS16550=y
CONFIG_SYS_NS16550_MEM32=y
CONFIG_BAUDRATE=115200
CONFIG_MMC=y
# CONFIG_MMC_WRITE is not set
# CONFIG_MMC_HW_PARTITIONING is not set
# CONFIG_SUPPORT_EMMC_BOOT is not set
# CONFIG_SUPPORT_EMMC_RPMB is not set
CONFIG_DOS_PARTITION=y
CONFIG_FS_FAT=y
# CONFIG_FAT_WRITE is not set
CONFIG_ENV_IS_NOWHERE=y
# CONFIG_NET is not set
# CONFIG_EFI_LOADER is not set
# CONFIG_ARMV8_PSCI is not set
# CONFIG_SYS_DCACHE_OFF is not set
CONFIG_SYS_ICACHE_OFF=y
# CONFIG_DISPLAY_CPUINFO is not set
CONFIG_DISPLAY_BOARDINFO=y
# CONFIG_TOOLS_LIBCRYPTO is not set
# CONFIG_TOOLS_KWBIMAGE is not set
# CONFIG_TOOLS_FIT_SIGNATURE is not set
CONFIG_CMD_SYSBOOT=y
CONFIG_CMD_EXT4=y
CONFIG_FS_EXT4=y
CONFIG_EFI_PARTITION=y
CONFIG_PARTITION_UUIDS=y
CONFIG_OF_BOARD_SETUP=y
CONFIG_BPI_M4_SPI=y
CONFIG_BPI_M4_RAM_SIZE=0x80000000
```
